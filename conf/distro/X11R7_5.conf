## conf/distro/X11R7_5.conf
```bitbake
#@TYPE: Distribution
#@NAME: lite
#@DESCRIPTION: OE-lite X Window System Version 11 Release 7.5 distro

require conf/distro/base.conf
require conf/mirror.conf

X11_VERSION     ?= "7.5"
```
